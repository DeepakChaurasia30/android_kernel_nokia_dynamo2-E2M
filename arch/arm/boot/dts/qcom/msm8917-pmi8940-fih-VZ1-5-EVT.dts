/*
 * Copyright (c) 2015-2016, The Linux Foundation. All rights reserved.
 *
 * This program is free software; you can redistribute it and/or modify
 * it under the terms of the GNU General Public License version 2 and
 * only version 2 as published by the Free Software Foundation.
 *
 * This program is distributed in the hope that it will be useful,
 * but WITHOUT ANY WARRANTY; without even the implied warranty of
 * MERCHANTABILITY or FITNESS FOR A PARTICULAR PURPOSE.  See the
 * GNU General Public License for more details.
 */

/dts-v1/;

#include "msm8917.dtsi"
#include "msm8917-pmi8940-fih-VZ1-5-EVT.dtsi"

/ {
	model = "Qualcomm Technologies, Inc. MSM8917-PMI8940 - FIH VZ1-5 EVT";
	compatible = "qcom,msm8917-mtp", "qcom,msm8917", "qcom,mtp";
	qcom,board-id= <0x9A 0>;
	qcom,msm-id = <303 0x1000>, <308 0x1000>, <309 0x1000>;
	qcom,pmic-id = <0x10019 0x020040 0x0 0x0>;
};
