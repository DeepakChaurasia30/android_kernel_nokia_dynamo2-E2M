/*
 * Copyright (c) 2017, The Linux Foundation. All rights reserved.
 *
 * This program is free software; you can redistribute it and/or modify
 * it under the terms of the GNU General Public License version 2 and
 * only version 2 as published by the Free Software Foundation.
 *
 * This program is distributed in the hope that it will be useful,
 * but WITHOUT ANY WARRANTY; without even the implied warranty of
 * MERCHANTABILITY or FITNESS FOR A PARTICULAR PURPOSE.  See the
 * GNU General Public License for more details.
 */

/dts-v1/;

#include "msm8917-E2M.dtsi"
#include "msm8917-pmi8940-mtp-E2M-DVT2.dtsi"

/ {
	model = "Qualcomm Technologies, Inc. MSM8917-PMI8940 MTP - E2M DVT2";
	compatible = "qcom,msm8917-mtp", "qcom,msm8917", "qcom,mtp";
	qcom,board-id = <161 0>;
	qcom,msm-id = <303 0x2002>, <308 0x2002>, <309 0x2002>;
	qcom,pmic-id = <0x10019 0x020040 0x0 0x0>;
};

/*
 * qcom,board-id = <161 0>;
 * >> CFG/HWID_E2M.csv:DeviceTree ID (161)
 * >> board_hardware_id()
 *    LINUX\android\bootable\bootloader\lk\platform\msm_shared\board.c
 * >> E2M = 161
 *
 * qcom,msm-id = <303 0x2002>, <308 0x2002>, <309 0x2002>;
 *                    ^^^^^^        ^^^^^^        ^^^^^^
 * >> board_fih_soc_version()
 *    LINUX\android\bootable\bootloader\lk\platform\msm_shared\board.c
 * >> FIH_REV_DVT2 = 0x2002
 *
 */
