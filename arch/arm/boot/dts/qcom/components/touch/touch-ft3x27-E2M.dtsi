&i2c_3 {
	status = "okay";
	focaltech@38 {
		compatible = "focaltech,fts";
		reg = <0x38>;
		interrput-parent = <&tlmm>;
		interrputs = <65 0x2008>;
		vdd-supply = <&pm8917_l10>;
		vcc_i2c-supply = <&pm8917_l6>;
		focaltech,display-coords = <0 0 720 1280>;
		focaltech,reset-gpio = <&tlmm 64 0x00>;
		focaltech,irq-gpio = <&tlmm 65 0x00>;
		focaltech,max-touch-number = <5>;
		pinctrl-names = "pmx_ts_active","pmx_ts_suspend","pmx_ts_release";
		pinctrl-0 = <&ts_int_active &ts_reset_active>;
		pinctrl-1 = <&ts_int_suspend &ts_reset_suspend>;
		pinctrl-2 = <&ts_release>;
	};
};
