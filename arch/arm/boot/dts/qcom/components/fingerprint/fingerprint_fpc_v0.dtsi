/* FPC FP */
fpc{
		compatible = "fpc,fpc1020";
		input-device-name = "fpc1020";
		interrupt-parent = <&tlmm>;
		interrupts = <48 0x0>;
		fpc,reset-gpio    = <&tlmm 89 0>;
		fpc,irq-gpio    = <&tlmm 48 0>;
		fpc,fpid-gpio    = <&tlmm 90 0>;
		vdd_io-supply   = <&pm8937_l5>;
		pinctrl-names = "pmx_fp_active","pmx_fp_suspend";
		pinctrl-0 = <&fp_int_active &fp_reset_active &fp_id_active>;
		pinctrl-1 = <&fp_reset_suspend>;		
};