/*
  FIH memory hole setting
*/

/* ref: msm8917.dtsi */

/ {
	reserved-memory {
		fih_mem: fih_region@0 {
			compatible = "removed-dma-pool";
			no-map;
			reg = <0 0x84A00000 0 0x00900000>;
		};
	};
};

/**************************************************************
 * START       | SIZE        | TARGET
 * -------------------------------------------------------- 0MB
 * 0x84A0_0000 | 0x0020_0000 | modem rf_nv (2MB)
 * 0x84C0_0000 | 0x0020_0000 | modem cust_nv (2MB)
 * 0x84E0_0000 | 0x0020_0000 | modem default_nv (2MB)
 * 0x8500_0000 | 0x0010_0000 | modem log (1MB)
  * -------------------------------------------------------- 7MB
 * 0x8510_0000 | 0x0004_0000 | last_alog_main (256KB)
 * 0x8514_0000 | 0x0004_0000 | last_alog_events (256KB)
 * 0x8518_0000 | 0x0004_0000 | last_alog_radio (256KB)
 * 0x851C_0000 | 0x0004_0000 | last_alog_system (256KB)
 * 0x8520_0000 | 0x0004_0000 | last_kmsg (256KB)
 * 0x8524_0000 | 0x0002_0000 | last_blog (128KB)
 * 0x8526_0000 | 0x0002_0000 | blog (128KB)
 * -------------------------------------------------------- 8.5MB
 * 0x8528_0000 | 0x0000_0040 | hwid:hwcfg (64B)
 * 0x8528_0040 | 0x0000_0040 | secboot:devinfo (64B)
 * 0x8528_0080 | 0x0000_0100 | secboot:unlock (256B)
 * 0x8528_0180 | 0x0000_0080 | sutinfo (128B)
 * 0x8528_0200 | 0x0000_0010 | no use (16B)
 * 0x8528_0210 | 0x0000_0010 | bset (16B)
 * 0x8528_0220 | 0x0000_0010 | bat-id adc (16B)
 * 0x8528_0230 | 0x0000_0010 | no use (16B)
 * 0x8528_0240 | 0x0000_0020 | apr (32B)
 * 0x8528_0260 | 0x0000_0180 | no use (384B)
 * 0x8528_03E0 | 0x0000_0020 | mem (32B)
 * 0x8528_0400 | 0x0000_0C00 | no use (3KB)
 * 0x8528_1000 | 0x0000_1000 | e2p (4KB)
 * 0x8528_2000 | 0x0000_1000 | cda (4KB)
 * 0x8528_3000 | 0x0000_1000 | note (4KB)
 * 0x8528_4000 | 0x0000_1000 | hwcfg (4KB)
 * 0x8528_5000 | 0x0000_1000 | fac (4KB)
 * 0x8528_6000 | 0x0000_2000 | no use 5 (8KB)
 * 0x8528_8000 | 0x0004_0000 | fver (256KB)
 * 0x852C_8000 | 0x0000_C000 | sensordata (48KB)
 * 0x852D_4000 | 0x0000_4000 | lcmdata (16KB)
 * 0x852D_8000 | 0x0002_8000 | no use 6 (160KB)
 * -------------------------------------------------------- 9MB
 * 0x8530_0000 | 0x0090_0000 | HLOS (9MB)
 */