/* Copyright (c) 2015, The Linux Foundation. All rights reserved.
 *
 * This program is free software; you can redistribute it and/or modify
 * it under the terms of the GNU General Public License version 2 and
 * only version 2 as published by the Free Software Foundation.
 *
 * This program is distributed in the hope that it will be useful,
 * but WITHOUT ANY WARRANTY; without even the implied warranty of
 * MERCHANTABILITY or FITNESS FOR A PARTICULAR PURPOSE.  See the
 * GNU General Public License for more details.
 */

/*---------------------------------------------------------------------------
 * This file is autogenerated file using gcdb parser. Please do not edit it.
 * Update input XML file to add a new entry or update variable in this file
 * VERSION = "1.0"
 *---------------------------------------------------------------------------*/
&mdss_mdp {
	dsi_pj050ia_nt35521s_720p_vid: fih,mdss_dsi_pj050ia_nt35521s_720p_video {
		fih,panel-id = <5>;
		qcom,mdss-dsi-panel-name = "PA050IA nt35521s 720p video mode dsi panel";
		qcom,mdss-dsi-panel-controller = <&mdss_dsi0>;
		qcom,mdss-dsi-panel-type = "dsi_video_mode";
		qcom,mdss-dsi-panel-destination = "display_1";
		qcom,mdss-dsi-panel-framerate = <60>;
		qcom,mdss-dsi-virtual-channel-id = <0>;
		qcom,mdss-dsi-stream = <0>;
		qcom,mdss-dsi-panel-width = <720>;
		qcom,mdss-dsi-panel-height = <1280>;
		qcom,mdss-dsi-h-front-porch = <100>;
		qcom,mdss-dsi-h-back-porch = <100>;
		qcom,mdss-dsi-h-pulse-width = <20>;
		qcom,mdss-dsi-h-sync-skew = <0>;
		qcom,mdss-dsi-v-front-porch = <120>;
		qcom,mdss-dsi-v-back-porch = <60>;
		qcom,mdss-dsi-v-pulse-width = <2>;
		qcom,mdss-dsi-h-left-border = <0>;
		qcom,mdss-dsi-h-right-border = <0>;
		qcom,mdss-dsi-v-top-border = <0>;
		qcom,mdss-dsi-v-bottom-border = <0>;
		qcom,mdss-dsi-bpp = <24>;
		qcom,mdss-dsi-underflow-color = <0xff>;
		qcom,mdss-dsi-border-color = <0>;
		qcom,mdss-dsi-on-command = [
			39 01 00 00 00 00 06 F0 55 AA 52 08 00
			05 01 00 00 0A 00 02 C8 00
			05 01 00 00 96 00 02 11 00
			05 01 00 00 0A 00 02 29 00
		];
		qcom,mdss-dsi-off-command = [
			05 01 00 00 0A 00 02 28 00
			05 01 00 00 96 00 02 10 00
		];

		qcom,mdss-dsi-ce-on-command = [
			39 01 00 00 00 00 02 51 FF
			39 01 00 00 00 00 02 53 2C
			39 01 00 00 00 00 02 55 80
		];
		qcom,mdss-dsi-ce-off-command = [
			39 01 00 00 00 00 02 51 FF
			39 01 00 00 00 00 02 53 2C
			39 01 00 00 00 00 02 55 00
		];

		qcom,mdss-dsi-ct-normal-command = [
			39 00 00 00 00 00 06 F0 55 AA 52 08 02
			39 01 00 00 00 00 02 EE 00
			39 00 00 00 00 00 06 F0 55 AA 52 08 00
			39 01 00 00 00 00 02 26 04
			39 01 00 00 00 00 02 26 01
		];
		qcom,mdss-dsi-ct-warm-command = [
			39 00 00 00 00 00 06 F0 55 AA 52 08 02
			39 01 00 00 00 00 02 EE 00
			39 00 00 00 00 00 06 F0 55 AA 52 08 00
			39 01 00 00 00 00 02 26 01
			39 01 00 00 00 00 02 26 02
		];
		qcom,mdss-dsi-ct-cold-command = [
			39 00 00 00 00 00 06 F0 55 AA 52 08 02
			39 01 00 00 00 00 02 EE 00
			39 00 00 00 00 00 06 F0 55 AA 52 08 00
			39 01 00 00 00 00 02 26 02
			39 01 00 00 00 00 02 26 04
		];
		qcom,mdss-dsi-blf-10-command = [
			39 00 00 00 00 00 06 F0 55 AA 52 08 02
			39 01 00 00 00 00 02 EE 03
			39 00 00 00 00 00 11 B0 00 14 00 28 00 47 00 61 00 78 00 9D 00 BB 00 EC
			39 01 00 00 00 00 11 B1 01 12 01 4F 01 7E 01 C6 02 01 02 03 02 38 02 75
			39 00 00 00 00 00 11 B2 02 9F 02 D7 02 FC 03 2C 03 4C 03 72 03 8B 03 A7
			39 01 00 00 00 00 05 B3 03 CD 03 D5
			39 00 00 00 00 00 11 B4 01 02 01 06 01 0E 01 16 01 1E 01 2C 01 3A 01 52
			39 01 00 00 00 00 11 B5 01 68 01 8E 01 AF 01 E6 02 18 02 19 02 49 02 85
			39 00 00 00 00 00 11 B6 02 AE 02 E5 03 0A 03 38 03 56 03 7C 03 91 03 AD
			39 01 00 00 00 00 05 B7 03 CE 03 D5
			39 00 00 00 00 00 11 B8 01 46 01 48 01 4D 01 53 01 57 01 61 01 6A 01 7C
			39 01 00 00 00 00 11 B9 01 8D 01 AA 01 C6 01 F5 02 20 02 22 02 50 02 8C
			39 00 00 00 00 00 11 BA 02 B4 02 E9 03 0D 03 3B 03 57 03 7C 03 90 03 A8
			39 01 00 00 00 00 05 BB 03 CC 03 D5
		];
		qcom,mdss-dsi-blf-30-command = [
			39 00 00 00 00 00 06 F0 55 AA 52 08 02
			39 01 00 00 00 00 02 EE 03
			39 00 00 00 00 00 11 B0 00 14 00 28 00 47 00 61 00 78 00 9D 00 BB 00 EC
			39 01 00 00 00 00 11 B1 01 12 01 4F 01 7E 01 C6 02 01 02 03 02 38 02 75
			39 00 00 00 00 00 11 B2 02 9F 02 D7 02 FC 03 2C 03 4C 03 72 03 8B 03 A7
			39 01 00 00 00 00 05 B3 03 CD 03 D5
			39 00 00 00 00 00 11 B4 01 02 01 06 01 0E 01 16 01 1E 01 2C 01 3A 01 52
			39 01 00 00 00 00 11 B5 01 68 01 8E 01 AF 01 E6 02 18 02 19 02 49 02 85
			39 00 00 00 00 00 11 B6 02 AE 02 E5 03 0A 03 38 03 56 03 7C 03 91 03 AD
			39 01 00 00 00 00 05 B7 03 CE 03 D5
			39 00 00 00 00 00 11 B8 01 76 01 77 01 7B 01 7F 01 83 01 8B 01 92 01 A0
			39 01 00 00 00 00 11 B9 01 AE 01 C6 01 DD 02 07 02 2E 02 2F 02 5C 02 96
			39 00 00 00 00 00 11 BA 02 BE 02 F4 03 17 03 47 03 66 03 94 03 BF 03 CA
			39 01 00 00 00 00 05 BB 03 CE 03 D5
		];
		qcom,mdss-dsi-blf-50-command = [
			39 00 00 00 00 00 06 F0 55 AA 52 08 02
			39 01 00 00 00 00 02 EE 03
			39 00 00 00 00 00 11 B0 00 14 00 28 00 47 00 61 00 78 00 9D 00 BB 00 EC
			39 01 00 00 00 00 11 B1 01 12 01 4F 01 7E 01 C6 02 01 02 03 02 38 02 75
			39 00 00 00 00 00 11 B2 02 9F 02 D7 02 FC 03 2C 03 4C 03 72 03 8B 03 A7
			39 01 00 00 00 00 05 B3 03 CD 03 D5
			39 00 00 00 00 00 11 B4 01 02 01 06 01 0E 01 16 01 1E 01 2C 01 3A 01 52
			39 01 00 00 00 00 11 B5 01 68 01 8E 01 AF 01 E6 02 18 02 19 02 49 02 85
			39 00 00 00 00 00 11 B6 02 AE 02 E5 03 0A 03 38 03 56 03 7C 03 91 03 AD
			39 01 00 00 00 00 05 B7 03 CE 03 D5
			39 00 00 00 00 00 11 B8 01 8A 01 8B 01 8F 01 92 01 96 01 9C 01 A3 01 AF
			39 01 00 00 00 00 11 B9 01 BC 01 D2 01 E7 02 0E 02 35 02 36 02 62 02 9C
			39 00 00 00 00 00 11 BA 02 C3 02 F8 03 1B 03 46 03 61 03 81 03 97 03 AC
			39 01 00 00 00 00 05 BB 03 BC 03 D5
		];
		qcom,mdss-dsi-blf-75-command = [
			39 00 00 00 00 00 06 F0 55 AA 52 08 02
			39 01 00 00 00 00 02 EE 03
			39 00 00 00 00 00 11 B0 00 14 00 28 00 47 00 61 00 78 00 9D 00 BB 00 EC
			39 01 00 00 00 00 11 B1 01 12 01 4F 01 7E 01 C6 02 01 02 03 02 38 02 75
			39 00 00 00 00 00 11 B2 02 9F 02 D7 02 FC 03 2C 03 4C 03 72 03 8B 03 A7
			39 01 00 00 00 00 05 B3 03 CD 03 D5
			39 00 00 00 00 00 11 B4 01 02 01 06 01 0E 01 16 01 1E 01 2C 01 3A 01 52
			39 01 00 00 00 00 11 B5 01 68 01 8E 01 AF 01 E6 02 18 02 19 02 49 02 85
			39 00 00 00 00 00 11 B6 02 AE 02 E5 03 0A 03 38 03 56 03 7C 03 91 03 AD
			39 01 00 00 00 00 05 B7 03 CE 03 D5
			39 00 00 00 00 00 11 B8 01 97 01 98 01 9B 01 9E 01 A1 01 A8 01 AE 01 BA
			39 01 00 00 00 00 11 B9 01 C5 01 DB 01 EE 02 14 02 39 02 3B 02 66 02 A0
			39 00 00 00 00 00 11 BA 02 C7 02 FB 03 1E 03 49 03 63 03 86 03 98 03 AD
			39 01 00 00 00 00 05 BB 03 BC 03 D5
		];

		qcom,mdss-dsi-cabc-off-command = [
			39 01 00 00 00 00 02 51 FF
			39 01 00 00 00 00 02 53 2C
			39 01 00 00 00 00 02 55 00
		];

		qcom,mdss-dsi-cabc-ui-command = [
			39 01 00 00 00 00 02 51 FF
			39 01 00 00 00 00 02 53 2C
			39 01 00 00 00 00 02 55 01
		];

		qcom,mdss-dsi-cabc-still-command = [
			39 01 00 00 00 00 02 51 FF
			39 01 00 00 00 00 02 53 2C
			39 01 00 00 00 00 02 55 02
		];

		qcom,mdss-dsi-cabc-moving-command = [
			39 01 00 00 00 00 02 51 FF
			39 01 00 00 00 00 02 53 2C
			39 01 00 00 00 00 02 55 03
		];

		qcom,mdss-dsi-on-command-state = "dsi_lp_mode";
		qcom,mdss-dsi-off-command-state = "dsi_hs_mode";

		qcom,mdss-dsi-ce-on-command-state = "dsi_lp_mode";
		qcom,mdss-dsi-ce-off-command-state = "dsi_lp_mode";

		qcom,mdss-dsi-ct-normal-command-state = "dsi_lp_mode";
		qcom,mdss-dsi-ct-warm-command-state = "dsi_lp_mode";
		qcom,mdss-dsi-ct-cold-command-state = "dsi_lp_mode";
		qcom,mdss-dsi-blf-10-command-state = "dsi_lp_mode";
		qcom,mdss-dsi-blf-30-command-state = "dsi_lp_mode";
		qcom,mdss-dsi-blf-50-command-state = "dsi_lp_mode";
		qcom,mdss-dsi-blf-75-command-state = "dsi_lp_mode";

		qcom,mdss-dsi-cabc-off-command-state = "dsi_lp_mode";
		qcom,mdss-dsi-cabc-ui-command-state = "dsi_lp_mode";
		qcom,mdss-dsi-cabc-still-command-state = "dsi_lp_mode";
		qcom,mdss-dsi-cabc-moving-command-state = "dsi_lp_mode";

		qcom,mdss-dsi-h-sync-pulse = <1>;
		qcom,mdss-dsi-traffic-mode = "burst_mode";
		qcom,mdss-dsi-bllp-eof-power-mode;
		qcom,mdss-dsi-bllp-power-mode;
		qcom,mdss-dsi-lane-0-state;
		qcom,mdss-dsi-lane-1-state;
		qcom,mdss-dsi-lane-2-state;
		qcom,mdss-dsi-lane-3-state;
		qcom,mdss-dsi-panel-timings = [8B 1E 14 00 44 48 18 22 19 03 04 00];
		qcom,mdss-dsi-t-clk-post = <0x04>;
		qcom,mdss-dsi-t-clk-pre = <0x1C>;
		qcom,mdss-dsi-bl-min-level = <1>;
		qcom,mdss-dsi-bl-max-level = <3050>;
		qcom,mdss-dsi-dma-trigger = "trigger_sw";
		qcom,mdss-dsi-mdp-trigger = "none";
		qcom,mdss-dsi-bl-pmic-control-type = "bl_ctrl_wled";
		qcom,mdss-dsi-reset-sequence = <1 2>, <0 10>, <1 20>;
		qcom,mdss-pan-physical-width-dimension = <64>;
		qcom,mdss-pan-physical-height-dimension = <117>;
		qcom,mdss-pan-physical-width-dimension-full = <6417>;
		qcom,mdss-pan-physical-height-dimension-full = <11756>;
		qcom,mdss-dsi-lp11-init;
		qcom,mdss-dsi-init-delay-us = <100>;
	};
};

