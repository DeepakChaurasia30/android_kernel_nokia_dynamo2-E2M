## drivers/input/touchscreen/focaltech_touch_E2M/Kconfig
```kconfig
#
# Focaltech Touchscreen driver configuration
#

config TOUCHSCREEN_FTS_E2M
        bool "Focaltech Touchscreen"
	default N
	help
	  Say Y here if you have Focaltech touch panel.
	  If unsure, say N.

config TOUCHSCREEN_FTS_DIRECTORY_E2M
    string "Focaltech ts directory name"
    default "focaltech_touch"
    depends on TOUCHSCREEN_FTS_E2M
    
```

## drivers/input/touchscreen/ft5446/Kconfig
```kconfig
#
# FocalTech FT5446 Touchscreen driver
#

config TOUCHSCREEN_FTS
       bool "FocalTech touchscreens"
       depends on I2C
       default n
       help
         Say Y here if you have a ft5446 touchscreen.
         Ft5446 controllers are multi touch controllers which can
         report 5 touches at a time.

         If unsure, say N.

         To compile this driver as a module, choose M here: the
         module will be called fts_ts.
```
